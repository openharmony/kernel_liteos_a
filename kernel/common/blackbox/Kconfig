## kernel/common/blackbox/Kconfig
```kconfig
config BLACKBOX
    bool "Enable BlackBox"
    default y
    help
      Answer Y to enable LiteOS support blackbox

config LOG_ROOT_PATH
    string
    default "/storage/data/log" if BLACKBOX
    help
      define the default log path of blackbox
```
